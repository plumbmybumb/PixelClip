## firmware/components/display/Kconfig
```kconfig
menu "PixelClip display (RM67162 AMOLED)"

    config HAIRCLIP_LCD_PCLK_MHZ
        int "AMOLED QSPI clock (MHz)"
        range 10 80
        default 40
        help
            QSPI clock for the RM67162 panel. 40 MHz is what the Waveshare demo uses and is
            verified on this board; 80 MHz roughly halves flush time but is untested.

    config HAIRCLIP_LCD_BOUNCE_ROWS
        int "Rows per DMA bounce band"
        range 8 60
        default 24
        help
            The PSRAM framebuffer is flushed through two internal-RAM DMA buffers of
            536 x N x 2 bytes each. Larger bands mean fewer SPI transactions but more internal RAM.
            Odd values are rounded down to even (the panel's window needs even start rows).

    config HAIRCLIP_LCD_EN_GPIO
        int "Display enable GPIO (-1 = none)"
        range -1 48
        default -1
        help
            GPIO that powers / enables the panel and must be driven high before the panel is reset and
            initialised. -1 (the Waveshare ESP32-S3-AMOLED-1.91 the PixelClip uses) = no such pin.
            LilyGo T-Display-S3 AMOLED V2: 38. The pin is kept driven (also during light sleep).

    config HAIRCLIP_LCD_MADCTL
        hex "MADCTL (0x36) value for the upright landscape picture"
        range 0x00 0xFF
        default 0xF0
        help
            Memory access control written by the init sequence. 0xF0 (MY|MX|MV|ML) is the Waveshare
            board's upright 536x240 landscape. Other boards with the same RM67162 panel may mount it
            differently (LilyGo's own driver uses 0x60 = MX|MV); a 180 degree flip toggles MX|MY (0xC0)
            from this value (display_set_flipped()).
endmenu
```

## firmware/components/health/Kconfig
```kconfig
menu "PixelClip health (RTC watchdog, liveness)"

    config PIXELCLIP_RTC_WDT_TIMEOUT_S
        int "RTC watchdog timeout (s)"
        range 15 120
        default 40
        help
            The RTC watchdog keeps counting in light sleep (unlike the task watchdog) and is fed by the
            controller loop every 5 s while every required liveness source has checked in (health.h: player
            30 s, power task 15 s, and during a WiFi session the httpd task 30 s and the lwIP thread 15 s,
            the NimBLE host 30 s while BLE runs). If the chip sleeps without waking, or a source is silent,
            it resets the chip after this time (system reset; a full RTC reset 5 s later if that did not
            help). The boot log then says "reset reason RTCWDT_..." and names the silent source.

endmenu
```

## firmware/components/imu/Kconfig
```kconfig
menu "PixelClip IMU (QMI8658C)"

    config PIXELCLIP_IMU_ENABLE
        bool "Use the QMI8658C accelerometer"
        default y
        help
            I2C on SCL=GPIO39 / SDA=GPIO40, 400 kHz. When disabled (or the chip is not found) live
            scenes use a fixed downward gravity.

    config PIXELCLIP_IMU_FLIP_X
        bool "Flip display-frame X (left/right) of the gravity vector"
        default n
        help
            Bench fix for the axis assumption in components/imu/imu.c (IMU_AXIS_MAP). With the clip
            upright and its RIGHT edge tilted down, GET /imu must report g[0] > 0. If it is negative,
            enable this.

    config PIXELCLIP_IMU_FLIP_Y
        bool "Flip display-frame Y (up/down) of the gravity vector"
        default n
        help
            Upright clip (display landscape, readable): GET /imu must report g[1] close to +1.
            If it reads -1, enable this.

    config PIXELCLIP_IMU_FLIP_Z
        bool "Flip display-frame Z (out of / into the glass) of the gravity vector"
        default n
        help
            Clip lying face up (glass toward the sky): GET /imu must report g[2] close to -1.
            If it reads +1, enable this.

    config PIXELCLIP_IMU_SWAP_XY
        bool "Swap display-frame X and Y (chip rotated 90 degrees on the board)"
        default n
        help
            Applied before the flips. Enable if tilting the clip left/right moves g[1] instead of
            g[0] (upright then reads g[0] = +-1 instead of g[1]).

    config PIXELCLIP_IMU_LOW_POWER
        bool "Accelerometer low-power mode (128 Hz ODR) instead of normal mode (62.5 Hz)"
        default n
        help
            The QMI8658C low-power accelerometer rates are 128/21/11/3 Hz; only 128 Hz is fast enough
            for the 50 Hz sampling. Normal mode at 62.5 Hz is the default (verified register values
            from the Waveshare demo family); try this on the bench to save a little current.

endmenu
```

## firmware/components/power/Kconfig
```kconfig
menu "PixelClip power (battery ADC, DFS, light sleep)"

    config HAIRCLIP_CPU_MAX_MHZ
        int "CPU frequency while decoding / in upload mode (MHz)"
        range 80 240
        default 160

    config HAIRCLIP_CPU_MIN_MHZ
        int "Idle CPU frequency (MHz)"
        range 40 160
        default 80

    config HAIRCLIP_AUTO_LIGHT_SLEEP
        bool "Enable automatic light sleep"
        default y

    config HAIRCLIP_BATTERY_SAMPLE_S
        int "Battery sampling period (s)"
        range 5 300
        default 30

    config HAIRCLIP_BAT_ADC_GPIO
        int "Battery divider ADC GPIO (ADC1 only)"
        range 1 10
        default 1
        help
            GPIO of the battery divider midpoint (100k/100k assumed: the reading is doubled). Must be an
            ADC1 pin (GPIO1..10 on the ESP32-S3; ADC2 is unusable while WiFi runs).
            Waveshare ESP32-S3-AMOLED-1.91 (PixelClip): 1. LilyGo T-Display-S3 AMOLED: 4.
endmenu
```

## firmware/components/timekeeping/Kconfig
```kconfig
menu "Timekeeping"

config TIMEKEEPING_KEEP_RTC_MORE
    bool "Keep a synced clock across USB / JTAG resets and short deep sleeps"
    default n
    help
        The RTC timer keeps counting through ESP_RST_USB, ESP_RST_JTAG and a deep-sleep wake. With this on, those
        resets keep a synced clock synced (a deep sleep only while it was shorter than 1 h; a longer one turns the
        clock approximate for RC drift). Off (the default, the PixelClip): only software resets, panics and
        watchdogs keep trust, as before.

endmenu
```

## firmware/main/Kconfig.projbuild
```kconfig
menu "Hair Clip"

    # Options of reusable components live with the component, so other projects that reuse them
    # get them too: display (HAIRCLIP_LCD_*) in components/display/Kconfig, power
    # (HAIRCLIP_CPU_*, HAIRCLIP_AUTO_LIGHT_SLEEP, HAIRCLIP_BATTERY_SAMPLE_S, HAIRCLIP_BAT_ADC_GPIO) in
    # components/power/Kconfig, PIXELCLIP_RTC_WDT_TIMEOUT_S in components/health/Kconfig.

    config HAIRCLIP_WIFI_CHANNEL
        int "SoftAP channel"
        range 1 13
        default 6

    config HAIRCLIP_WIFI_MAX_TX_DBM
        int "SoftAP max TX power on USB (dBm)"
        range 2 20
        default 10
        help
            Caps radio TX power to limit peak current and heat (500 mAh / 0.5 A cell; the SoftAP
            idles at roughly 100 mA, TX bursts reach ~300 mA at full power).

    config HAIRCLIP_WIFI_MAX_TX_DBM_BATTERY
        int "SoftAP max TX power on battery (dBm)"
        range 2 20
        default 8
        help
            TX cap used when the session starts (or USB is unplugged during it) without USB power.
            Lower than the USB cap: TX bursts sag the 500 mAh cell (README "Light sleep on battery").
            A phone within a metre or two does not need more.

    config PIXELCLIP_BENCH_SLEEP_TEST
        bool "Bench: light-sleep soak test (NOT for the clip)"
        default n
        help
            Bench reproduction of the battery hang (README "Light sleep on battery"): automatic light sleep
            also while USB is connected (requires CONFIG_USJ_NO_AUTO_LS_ON_CONNECTION=n: build with
            sdkconfig.bench, e.g. BENCH=1 scripts/flash.sh), an upload session every few minutes, a 4 px
            heartbeat dot in the bottom-left corner and a status line every 30 s for scripts/sleep_soak.sh.

    config PIXELCLIP_BENCH_FIRST_S
        int "Bench: first session after boot (s)"
        depends on PIXELCLIP_BENCH_SLEEP_TEST
        default 20

    config PIXELCLIP_BENCH_SESSION_S
        int "Bench: session length (s)"
        depends on PIXELCLIP_BENCH_SLEEP_TEST
        default 40

    config PIXELCLIP_BENCH_PERIOD_S
        int "Bench: session period (s)"
        depends on PIXELCLIP_BENCH_SLEEP_TEST
        default 120

    config PIXELCLIP_BENCH_WIFI_DEINIT
        bool "Bench: old session end (esp_wifi_deinit with BLE on) to confirm the root cause"
        depends on PIXELCLIP_BENCH_SLEEP_TEST
        default n
        help
            Restores the pre-fix session end (WiFi driver deinitialised while NimBLE + coexistence run).
            Soak once with and once without: a hang (RTCWDT reset) only with it confirms the cause.

    config PIXELCLIP_BENCH_STRESS
        bool "Bench: stress session (NOT for the clip)"
        default n
        help
            Bench reproduction of the session hang (README "Bench: stress session, watchdog and crash tests"): on
            USB, opens a screen-on upload session after CONFIG_PIXELCLIP_BENCH_STRESS_FIRST_S, plays the water scene
            and stores a 200 KB glyph atlas (generated, embedded) through the same storage path as PUT /assets
            every CONFIG_PIXELCLIP_BENCH_STRESS_PERIOD_S while the BLE fast lane stays up, logging the internal heap
            after each store. Build with sdkconfig.stress (STRESS=1 scripts/flash.sh). Also enables the
            /bench/crash and /bench/wedge routes.

    config PIXELCLIP_BENCH_STRESS_FIRST_S
        int "Bench stress: first session after boot (s)"
        depends on PIXELCLIP_BENCH_STRESS
        default 20

    config PIXELCLIP_BENCH_STRESS_PERIOD_S
        int "Bench stress: one self-upload every (s)"
        depends on PIXELCLIP_BENCH_STRESS
        default 30

    config PIXELCLIP_BENCH_ROUTES
        bool "Bench: POST /bench/crash and /bench/wedge (NOT for the clip)"
        default y if PIXELCLIP_BENCH_SLEEP_TEST || PIXELCLIP_BENCH_STRESS
        default n
        help
            Deliberate faults that prove the safety nets end to end (health.h): a panic with a core dump
            ({"kind":"abort|assert|null|stack"}) and wedges that only the RTC watchdog can end
            ({"mode":"sleep|suspend|irqoff|player|power|httpd|tcpip|ble|controller"}). Also over the BLE
            fast lane (scripts/ble_api.py POST /bench/wedge '{"mode":"sleep"}').

endmenu
```
